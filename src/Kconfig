## src/core/Kconfig
```kconfig
#
# For a description of the syntax of this configuration file,
# see the file kconfig-language.txt in the NuttX tools repository.
#

config KAMELEON
  bool "Kameleon"
  default y
  ---help---
    Enable Kameleon platform

if KAMELEON

config KAMELEON_PRIORITY
  int "Kameleon task priority"
  default 100

config KAMELEON_STACKSIZE
  int "Kameleon stack size"
  default 16384

endif
```
